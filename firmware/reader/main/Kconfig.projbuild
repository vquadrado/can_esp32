## firmware/reader/main/Kconfig.projbuild
```kconfig
menu "CAN reader"

    config READER_TWAI_TX_GPIO
        int "TWAI TX GPIO"
        default 4
        help
            Pull-up, held HIGH at boot (recessive).

    config READER_TWAI_RX_GPIO
        int "TWAI RX GPIO"
        default 5

    config READER_ALLOW_TX
        bool "Allow OBD transmit (CLI tx on)"
        default n
        help
            Keep disabled on the car until docs/yaris_xs_2023_can.md exists.

    config READER_STATS_PERIOD_S
        int "Stats print period (seconds, 0=off)"
        default 1

    config READER_LOG_ALL
        bool "Log every 11-bit frame"
        default y

endmenu
```

## firmware/reader/sdkconfig.defaults
```kconfig
CONFIG_IDF_TARGET="esp32s3"
CONFIG_ESP_CONSOLE_USB_SERIAL_JTAG=y
CONFIG_ESP_TASK_WDT_EN=y
CONFIG_ESP_TASK_WDT_TIMEOUT_S=10
CONFIG_ESP_TASK_WDT_CHECK_IDLE_TASK_CPU0=y
CONFIG_ESP_TASK_WDT_CHECK_IDLE_TASK_CPU1=y
CONFIG_FREERTOS_HZ=1000
CONFIG_READER_TWAI_TX_GPIO=4
CONFIG_READER_TWAI_RX_GPIO=5
CONFIG_READER_ALLOW_TX=n
CONFIG_READER_STATS_PERIOD_S=1
```
